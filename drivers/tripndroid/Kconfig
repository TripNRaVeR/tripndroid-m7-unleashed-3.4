## drivers/tripndroid/Kconfig
```kconfig
menu "TripNDroid Framework"

config TRIPNDROID_FRAMEWORK
	bool "TripNDroid Framework"
	select ARM_L1_CACHE_SHIFT_6
	default n
	help
	  Implement a custom kernel overhaul for mobile Android devices.
	  Currently only supporting Tegra 3 cpu's. Will be platform
	  independent in the future

config TDF_DEBUG
	bool "TDF debugging"
	default n
	help
	  Say yes here to add debug information to last_kmsg
	  Adds huge overhead so leave disabled unless really needed

menuconfig TDF_CPU_MANAGEMENT
	bool "TDF CPU Management"
	depends on TRIPNDROID_FRAMEWORK
	default n
	help
	  Choose this option if you want TDF to control the cpus

	source "drivers/tripndroid/cpu_management/Kconfig"

menuconfig TDF_SCHED_MANAGEMENT
	bool "TDF Scheduler Management"
	depends on TRIPNDROID_FRAMEWORK
	default n
	help
	  Choose this option if you want TDF to control the linux scheduler

	source "drivers/tripndroid/sched_management/Kconfig"


endmenu
```
